## config/west.yml
```yaml
manifest:
  remotes:
    - name: zmkfirmware
      url-base: https://github.com/zmkfirmware
    - name: SzCsaba01
      url-base: https://github.com/SzCsaba01
  projects:
    - name: zmk
      remote: zmkfirmware
      revision: v1.3.0
      import: app/west.yml
    - name: sofle-nice-shield
      remote: SzCsaba01
      revision: main
  self:
    path: config
```
